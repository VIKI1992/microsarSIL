AUTOSAR XML (schema 00049)
package /ActiveEcuC
  module config Os
    OsOS:
      OsNumberOfCores = 2
      OsStatus = EXTENDED
      OsStackMonitoring = true
      OsUseResScheduler = false
      OsScalabilityClass = SC1
      OsUseGetServiceId = true
      OsUseParameterAccess = true
      OsMasterCore = OsCore0
      OsSystemTimer = SystemTimer_Core0
      OsHooks: OsErrorHook=true, OsShutdownHook=true, OsStartupHook=true, OsPreTaskHook=false, OsPostTaskHook=false, OsProtectionHook=false
    OsCore0 (OsCore): OsCoreId=0, OsCoreIsAutostart=true
    OsCore1 (OsCore): OsCoreId=1, OsCoreIsAutostart=true
    OSDEFAULTAPPMODE (OsAppMode)
    OS_APPMODE_ANY (OsAppMode)
    SystemTimer_Core0 (OsCounter): OsCounterMaxAllowedValue=1000000000, OsCounterMinCycle=1, OsCounterTicksPerBase=40000, OsCounterType=HARDWARE, OsSecondsPerTick=0.001
      OsDriver: OsDriverIsrRef=CounterIsr_SystemTimer_Core0
    CounterIsr_SystemTimer_Core0 (OsIsr):
      OsIsrCategory = CATEGORY_2
      OsIsrInterruptPriority = 15
      OsIsrEnableNesting = false
      OsIsrInitialEnableInterruptSource = false
      OsIsrSpecialFunctionName = Os_TimerPfrtIsr
      OsIsrStackSize = 1024
    XSignalIsr_OsCore0 (OsIsr):
      OsIsrCategory = CATEGORY_2
      OsIsrInterruptPriority = 16
      OsIsrEnableNesting = false
      OsIsrInitialEnableInterruptSource = false
      OsIsrSpecialFunctionName = Os_XSigRecvIsrHandler
      OsIsrStackSize = 1024
    SystemTimer_Core1 (OsCounter): OsCounterMaxAllowedValue=1000000000, OsCounterMinCycle=1, OsCounterTicksPerBase=40000, OsCounterType=HARDWARE, OsSecondsPerTick=0.001
      OsDriver: OsDriverIsrRef=CounterIsr_SystemTimer_Core1
    16 x OsIsr, all with OsIsrCategory=CATEGORY_2, OsIsrStackSize=1024:
      CounterIsr_SystemTimer_Core1: OsIsrInterruptPriority=15, OsIsrEnableNesting=false, OsIsrInitialEnableInterruptSource=false, OsIsrSpecialFunctionName=Os_TimerPfrtIsr
      XSignalIsr_OsCore1: OsIsrInterruptPriority=16, OsIsrEnableNesting=false, OsIsrInitialEnableInterruptSource=false, OsIsrSpecialFunctionName=Os_XSigRecvIsrHandler
      Isr_CanRx: OsIsrInterruptPriority=32, OsIsrEnableNesting=false, OsIsrInitialEnableInterruptSource=true
      Isr_SpiDone: OsIsrInterruptPriority=16, OsIsrEnableNesting=false, OsIsrInitialEnableInterruptSource=true
      Isr_Button: OsIsrInterruptPriority=33, OsIsrEnableNesting=true, OsIsrInitialEnableInterruptSource=true
      CanIsr_0_Rx: OsIsrInterruptPriority=32, OsIsrEnableNesting=false, OsIsrInitialEnableInterruptSource=true, OsIsrSpecialFunctionName=CAN0_ORED_0_31_MB_IRQHandler
      CanIsr_0_Tx: OsIsrInterruptPriority=32, OsIsrEnableNesting=false, OsIsrInitialEnableInterruptSource=true, OsIsrSpecialFunctionName=CAN0_ORED_32_63_MB_IRQHandler
      CanIsr_0_BusOff: OsIsrInterruptPriority=32, OsIsrEnableNesting=false, OsIsrInitialEnableInterruptSource=true, OsIsrSpecialFunctionName=CAN0_ORED_IRQHandler
      CanIsr_1_Rx: OsIsrInterruptPriority=32, OsIsrEnableNesting=false, OsIsrInitialEnableInterruptSource=true, OsIsrSpecialFunctionName=CAN1_ORED_0_31_MB_IRQHandler
      CanIsr_1_Tx: OsIsrInterruptPriority=32, OsIsrEnableNesting=false, OsIsrInitialEnableInterruptSource=true, OsIsrSpecialFunctionName=CAN1_ORED_32_63_MB_IRQHandler
      CanIsr_1_BusOff: OsIsrInterruptPriority=32, OsIsrEnableNesting=false, OsIsrInitialEnableInterruptSource=true, OsIsrSpecialFunctionName=CAN1_ORED_IRQHandler
      SpiIsr_0: OsIsrInterruptPriority=16, OsIsrEnableNesting=false, OsIsrInitialEnableInterruptSource=true, OsIsrSpecialFunctionName=Spi_Ip_SPI_0_IRQHandler
      I2cIsr_0: OsIsrInterruptPriority=32, OsIsrEnableNesting=false, OsIsrInitialEnableInterruptSource=true, OsIsrSpecialFunctionName=LPI2C0_Master_Slave_IRQHandler
      UartIsr_0: OsIsrInterruptPriority=32, OsIsrEnableNesting=false, OsIsrInitialEnableInterruptSource=true, OsIsrSpecialFunctionName=LINFLEXD0_UART_IRQHandler
      LinIsr_0: OsIsrInterruptPriority=32, OsIsrEnableNesting=false, OsIsrInitialEnableInterruptSource=true
      LinIsr_1: OsIsrInterruptPriority=32, OsIsrEnableNesting=false, OsIsrInitialEnableInterruptSource=true
    8 x OsEvent, all with OsEventMask=AUTO:
      Ev_1ms
      Ev_10ms
      Ev_CanRx
      Ev_10ms_Core1
      Ev_Trigger_Core1
      Ev_SpiDone
      Ev_AdcDone
      Ev_NvDone
    12 x OsTask, all with OsTaskStackSize=2048, OsTaskType=AUTO:
      IdleTask_OsCore0: OsTaskPriority=4294967295, OsTaskSchedule=FULL, OsTaskActivation=1
        OsTaskAutostart: OsTaskAppModeRef=OSDEFAULTAPPMODE
      IdleTask_OsCore1: OsTaskPriority=4294967295, OsTaskSchedule=FULL, OsTaskActivation=1
        OsTaskAutostart: OsTaskAppModeRef=OSDEFAULTAPPMODE
      InitTask_Core0: OsTaskPriority=40, OsTaskSchedule=NON, OsTaskActivation=1
        OsTaskAutostart: OsTaskAppModeRef=OSDEFAULTAPPMODE
      InitTask_Core1: OsTaskPriority=40, OsTaskSchedule=NON, OsTaskActivation=1
        OsTaskAutostart: OsTaskAppModeRef=OSDEFAULTAPPMODE
      Task_1ms_Core0: OsTaskPriority=30, OsTaskSchedule=FULL, OsTaskActivation=1, OsTaskEventRef=Ev_1ms, OsTaskEventRef=Ev_CanRx, OsTaskEventRef=Ev_SpiDone, OsTaskEventRef=Ev_NvDone, OsTaskResourceRef=Res_Shared
      Task_10ms_Core0: OsTaskPriority=20, OsTaskSchedule=FULL, OsTaskActivation=1, OsTaskEventRef=Ev_10ms, OsTaskEventRef=Ev_AdcDone, OsTaskResourceRef=Res_Shared
      Task_100ms_Core0: OsTaskPriority=10, OsTaskSchedule=FULL, OsTaskActivation=1
      Task_Bg_Core0: OsTaskPriority=1, OsTaskSchedule=FULL, OsTaskActivation=3
      Task_Hi_Core0: OsTaskPriority=35, OsTaskSchedule=FULL, OsTaskActivation=1
      Task_Coop_Core0: OsTaskPriority=5, OsTaskSchedule=NON, OsTaskActivation=1
      Task_10ms_Core1: OsTaskPriority=20, OsTaskSchedule=FULL, OsTaskActivation=1, OsTaskEventRef=Ev_10ms_Core1
      Task_Event_Core1: OsTaskPriority=25, OsTaskSchedule=FULL, OsTaskActivation=1, OsTaskEventRef=Ev_Trigger_Core1
    4 x OsAlarm:
      Al_1ms_Core0: OsAlarmCounterRef=SystemTimer_Core0
        OsAlarmAction
          OsAlarmSetEvent: OsAlarmSetEventRef=Ev_1ms, OsAlarmSetEventTaskRef=Task_1ms_Core0
      Al_10ms_Core0: OsAlarmCounterRef=SystemTimer_Core0
        OsAlarmAction
          OsAlarmSetEvent: OsAlarmSetEventRef=Ev_10ms, OsAlarmSetEventTaskRef=Task_10ms_Core0
      Al_100ms_Core0: OsAlarmCounterRef=SystemTimer_Core0
        OsAlarmAction
          OsAlarmActivateTask: OsAlarmActivateTaskRef=Task_100ms_Core0
        OsAlarmAutostart: OsAlarmAutostartType=RELATIVE, OsAlarmAlarmTime=100, OsAlarmCycleTime=100, OsAlarmAppModeRef=OSDEFAULTAPPMODE
      Al_10ms_Core1: OsAlarmCounterRef=SystemTimer_Core1
        OsAlarmAction
          OsAlarmSetEvent: OsAlarmSetEventRef=Ev_10ms_Core1, OsAlarmSetEventTaskRef=Task_10ms_Core1
    SchTbl_Core0 (OsScheduleTable): OsScheduleTableDuration=50, OsScheduleTableRepeating=true, OsScheduleTableCounterRef=SystemTimer_Core0
      Ep_0 (OsScheduleTableExpiryPoint): OsScheduleTblExpPointOffset=0
        Act_Bg (OsScheduleTableTaskActivation): OsScheduleTableActivateTaskRef=Task_Hi_Core0
      Ep_25 (OsScheduleTableExpiryPoint): OsScheduleTblExpPointOffset=25
        Act_Hi2 (OsScheduleTableTaskActivation): OsScheduleTableActivateTaskRef=Task_Hi_Core0
    Res_Shared (OsResource): OsResourceProperty=STANDARD
    Spin_Shared (OsSpinlock): OsSpinlockLockMethod=LOCK_CAT2_INTERRUPTS, OsSpinlockLockType=STANDARD
    Spin_Plain (OsSpinlock): OsSpinlockLockMethod=LOCK_NOTHING, OsSpinlockLockType=STANDARD
    Barrier_Init (OsBarrier): OsBarrierTaskRef=InitTask_Core0, OsBarrierTaskRef=InitTask_Core1
    OsIoc: OsIocIncludeHeader=Std_Types.h
      Ioc_Speed (OsIocCommunication): OsIocBufferLength=0
        Data0 (OsIocDataProperties): OsIocDataType=uint32, OsIocDataTypeIsAtomic=true, OsIocDataPropertyIndex=0
        S0 (OsIocSenderProperties): OsIocSenderId=0, OsIocSendingOsApplicationRef=App_Core0
        S1 (OsIocSenderProperties): OsIocSenderId=1, OsIocSendingOsApplicationRef=App_Core0
        R (OsIocReceiverProperties): OsIocReceivingOsApplicationRef=App_Core1
      Ioc_Samples (OsIocCommunication): OsIocBufferLength=8
        Data0 (OsIocDataProperties): OsIocDataType=uint16, OsIocDataTypeIsAtomic=true, OsIocDataPropertyIndex=0
        S0 (OsIocSenderProperties): OsIocSenderId=0, OsIocSendingOsApplicationRef=App_Core1
        R (OsIocReceiverProperties): OsIocReceivingOsApplicationRef=App_Core0
    4 x OsApplication, all with OsTrusted=true:
      SystemApplication_OsCore0: OsApplicationCoreRef=OsCore0, OsAppTaskRef=IdleTask_OsCore0, OsAppIsrRef=CounterIsr_SystemTimer_Core0, OsAppIsrRef=XSignalIsr_OsCore0, OsAppCounterRef=SystemTimer_Core0
      SystemApplication_OsCore1: OsApplicationCoreRef=OsCore1, OsAppTaskRef=IdleTask_OsCore1, OsAppIsrRef=CounterIsr_SystemTimer_Core1, OsAppIsrRef=XSignalIsr_OsCore1, OsAppCounterRef=SystemTimer_Core1
      App_Core0: OsApplicationCoreRef=OsCore0, OsAppTaskRef=InitTask_Core0, OsAppTaskRef=Task_1ms_Core0, OsAppTaskRef=Task_10ms_Core0, OsAppTaskRef=Task_100ms_Core0, OsAppTaskRef=Task_Bg_Core0, OsAppTaskRef=Task_Hi_Core0, OsAppTaskRef=Task_Coop_Core0, OsAppIsrRef=Isr_CanRx, OsAppIsrRef=Isr_SpiDone, OsAppIsrRef=Isr_Button, OsAppIsrRef=CanIsr_0_Rx, OsAppIsrRef=CanIsr_0_Tx, OsAppIsrRef=CanIsr_0_BusOff, OsAppIsrRef=CanIsr_1_Rx, OsAppIsrRef=CanIsr_1_Tx, OsAppIsrRef=CanIsr_1_BusOff, OsAppIsrRef=SpiIsr_0, OsAppIsrRef=I2cIsr_0, OsAppIsrRef=UartIsr_0, OsAppIsrRef=LinIsr_0, OsAppIsrRef=LinIsr_1, OsAppAlarmRef=Al_1ms_Core0, OsAppAlarmRef=Al_10ms_Core0, OsAppAlarmRef=Al_100ms_Core0, OsAppScheduleTableRef=SchTbl_Core0, OsAppResourceRef=Res_Shared
      App_Core1: OsApplicationCoreRef=OsCore1, OsAppTaskRef=InitTask_Core1, OsAppTaskRef=Task_10ms_Core1, OsAppTaskRef=Task_Event_Core1, OsAppAlarmRef=Al_10ms_Core1
