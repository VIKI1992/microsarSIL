AUTOSAR XML (schema 00049)
package /ActiveEcuC
  module config Can
    CanGeneral: CanDevErrorDetect=false, CanMainFunctionRwPeriod=0.001
    CT_CAN0 (CanController):
      CanControllerId = 0
      CanHwChannel = FLEXCAN_0
      CanControllerActivation = true
      CanRxProcessing = INTERRUPT
      CanTxProcessing = INTERRUPT
      CanBusoffProcessing = INTERRUPT
      CanControllerDefaultBaudrate = CT_CAN0/Baud500
      Baud500 (CanControllerBaudrateConfig): CanControllerBaudRate=500, CanControllerBaudRateConfigID=0
    CT_CAN1 (CanController):
      CanControllerId = 1
      CanHwChannel = FLEXCAN_1
      CanControllerActivation = true
      CanRxProcessing = INTERRUPT
      CanTxProcessing = INTERRUPT
      CanBusoffProcessing = INTERRUPT
      CanControllerDefaultBaudrate = CT_CAN1/Baud500
      Baud500 (CanControllerBaudrateConfig): CanControllerBaudRate=500, CanControllerBaudRateConfigID=0
    6 x CanHardwareObject:
      Can0_Tx: CanObjectId=0, CanObjectType=TRANSMIT, CanHandleType=BASIC, CanIdType=MIXED, CanHwObjectCount=8, CanControllerRef=CT_CAN0
      Can0_Rx_Cmd: CanObjectId=1, CanObjectType=RECEIVE, CanHandleType=BASIC, CanIdType=STANDARD, CanHwObjectCount=1, CanControllerRef=CT_CAN0
        F0 (CanHwFilter): CanHwFilterCode=512, CanHwFilterMask=1792
      Can0_Rx_Ext: CanObjectId=2, CanObjectType=RECEIVE, CanHandleType=BASIC, CanIdType=EXTENDED, CanHwObjectCount=1, CanControllerRef=CT_CAN0
      Can1_Tx: CanObjectId=3, CanObjectType=TRANSMIT, CanHandleType=BASIC, CanIdType=MIXED, CanHwObjectCount=8, CanControllerRef=CT_CAN1
      Can1_Rx_Status: CanObjectId=4, CanObjectType=RECEIVE, CanHandleType=FULL, CanIdType=STANDARD, CanHwObjectCount=1, CanControllerRef=CT_CAN1
        F0 (CanHwFilter): CanHwFilterCode=256, CanHwFilterMask=2047
      Can1_Rx_Any: CanObjectId=5, CanObjectType=RECEIVE, CanHandleType=BASIC, CanIdType=MIXED, CanHwObjectCount=1, CanControllerRef=CT_CAN1
