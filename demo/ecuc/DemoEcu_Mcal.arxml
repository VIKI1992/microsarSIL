AUTOSAR XML (schema 00049)
package /ActiveEcuC
  module config Dio
    PortA (DioPort): DioPortId=0
      4 x DioChannel:
        LED_GREEN: DioChannelId=1
        LED_RED: DioChannelId=2
        BUTTON: DioChannelId=5
        RELAY: DioChannelId=7
    PortB (DioPort): DioPortId=1
      SENSOR_PWR (DioChannel): DioChannelId=3
  module config Adc
    ADC_0 (AdcHwUnit): AdcHwUnitId=ADC0, AdcLogicalUnitId=0
      AdcChannel_Vbat (AdcChannel): AdcChannelId=0, AdcLogicalChannelId=0
      AdcChannel_Temp (AdcChannel): AdcChannelId=1, AdcLogicalChannelId=1
      AdcGroup_Sense (AdcGroup):
        AdcGroupId = 0
        AdcGroupConversionMode = ADC_CONV_MODE_ONESHOT
        AdcGroupAccessMode = ADC_ACCESS_MODE_SINGLE
        AdcGroupTriggSrc = ADC_TRIGG_SRC_SW
        AdcStreamingNumSamples = 1
        AdcNotification = Demo_AdcSenseNotification
        AdcGroupDefinition = AdcChannel_Vbat
        AdcGroupDefinition = AdcChannel_Temp
  module config Pwm
    PwmChannel_Fan (PwmChannel): PwmChannelId=0, PwmPeriodDefault=1000, PwmDutycycleDefault=0, PwmPolarity=PWM_HIGH, PwmIdleState=PWM_LOW
    PwmChannel_Heater (PwmChannel): PwmChannelId=1, PwmPeriodDefault=2000, PwmDutycycleDefault=16384, PwmPolarity=PWM_HIGH, PwmIdleState=PWM_LOW
  module config Icu
    3 x IcuChannel:
      IcuChannel_Speed: IcuChannelId=0, IcuMeasurementMode=ICU_MODE_SIGNAL_MEASUREMENT, IcuDefaultStartEdge=ICU_RISING_EDGE
        IcuSignalMeasurement: IcuSignalMeasurementProperty=ICU_PERIOD_TIME
      IcuChannel_Hall: IcuChannelId=1, IcuMeasurementMode=ICU_MODE_SIGNAL_EDGE_DETECT, IcuDefaultStartEdge=ICU_RISING_EDGE
        IcuSignalEdgeDetection: IcuSignalNotification=Demo_HallEdgeNotification
      IcuChannel_Pulses: IcuChannelId=2, IcuMeasurementMode=ICU_MODE_EDGE_COUNTER, IcuDefaultStartEdge=ICU_BOTH_EDGES
  module config Gpt
    GptChannel_Timeout (GptChannelConfiguration):
      GptChannelId = 0
      GptChannelMode = GPT_CH_MODE_ONESHOT
      GptChannelTickFrequency = 1000000
      GptChannelTickValueMax = 4294967295
      GptNotification = Demo_GptTimeoutNotification
  module config Spi
    SpiGeneral: SpiLevelDelivered=2
      SpiPhyUnit_SPI0 (SpiPhyUnit): SpiPhyUnitMapping=SPI_0, SpiPhyUnitMode=SPI_MASTER
    SpiExternalDevice_Sensor (SpiExternalDevice): SpiBaudrate=1000000, SpiCsIdentifier=PCS0, SpiHwUnit=CSIB0, SpiTimeClk2Cs=1e-06, SpiTimeCs2Clk=1e-06
    SpiChannel_Sensor (SpiChannel): SpiChannelId=0, SpiChannelType=EB, SpiDataWidth=8, SpiEbMaxLength=16, SpiIbNBuffers=1, SpiTransferStart=MSB
    SpiJob_Sensor (SpiJob): SpiJobId=0, SpiJobPriority=0, SpiDeviceAssignment=SpiExternalDevice_Sensor
      SpiChannelList: SpiChannelIndex=0, SpiChannelAssignment=SpiChannel_Sensor
    SpiSequence_Sensor (SpiSequence): SpiSequenceId=0, SpiInterruptibleSequence=false, SpiSeqEndNotification=Demo_SpiSensorEndNotification, SpiJobAssignment=SpiJob_Sensor
  module config Fee
    FeeGeneral: FeeVirtualPageSize=8, FeeNvmJobEndNotification=Demo_NvJobEndNotification, FeeNvmJobErrorNotification=Demo_NvJobErrorNotification
    FeeBlock_Odometer (FeeBlockConfiguration): FeeBlockNumber=1, FeeBlockSize=8, FeeImmediateData=false
    FeeBlock_Config (FeeBlockConfiguration): FeeBlockNumber=2, FeeBlockSize=16, FeeImmediateData=true
  module config MemAcc
    MemAccAddressArea_Data (MemAccAddressAreaConfiguration): MemAccAddressAreaId=0, MemAccJobEndNotificationName=NULL_PTR
      Sub0 (MemAccSubAddressAreaConfiguration): MemAccLogicalStartAddress=0, MemAccNumberOfSectors=4
  module config I2c
    I2cGlobalConfig
      I2cChannel_Sensors (I2cChannel): I2cChannelId=0, I2cHwChannel=LPI2C_0, I2cMasterSlaveConfiguration=MASTER_MODE
        I2cMasterConfiguration: I2cBaudRate=400000
  module config Uart
    UartChannel_Terminal (UartChannel): UartChannelId=0
      DetailModuleConfiguration: UartHwChannel=LinflexD_0, DesireBaudrate=LINFLEXD_UART_BAUDRATE_115200
  module config Lin
    LinGeneral: LinDevErrorDetect=true
    LinChannel_0 (LinChannel): LinChannelId=0, LinChannelBaudRate=19200, LinNodeType=MASTER, LinUart=0, LinChannelWakeupSupport=false
    LinChannel_1 (LinChannel): LinChannelId=1, LinChannelBaudRate=19200, LinNodeType=MASTER, LinUart=1, LinChannelWakeupSupport=false
